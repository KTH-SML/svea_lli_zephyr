## boards/arm/clicker4_stm32/Kconfig.board
```kconfig
config BOARD_CLICKER4_STM32
	bool "MikroE Clicker 4 for STM32 board"
	depends on SOC_STM32F767XX
```

## boards/arm/clicker4_stm32/clicker4_stm32_defconfig
```kconfig
# Enable MPU
CONFIG_ARM_MPU=y

# Enable GPIO
CONFIG_GPIO=y

# Enable Clocks
CONFIG_CLOCK_CONTROL=y

# Enable pin controller
CONFIG_PINCTRL=y

CONFIG_USB_DEVICE_INITIALIZE_AT_BOOT=y

# Enable USB device stack and CDC ACM by default
CONFIG_USB_CDC_ACM=y
CONFIG_USB_DEVICE_STACK=y
CONFIG_USB_DEVICE_INITIALIZE_AT_BOOT=y
CONFIG_USB_DEVICE_PRODUCT="SVEA-LLI"
CONFIG_USB_DEVICE_VID=0x0000
CONFIG_USB_DEVICE_PID=0x0001

# Enable serial and UART interrupt-driven support
CONFIG_SERIAL=y
CONFIG_UART_INTERRUPT_DRIVEN=y

# Set the console to USB CDC ACM by default
CONFIG_CONSOLE=y
CONFIG_UART_CONSOLE=y

# (Optional) Set default main stack size if needed
CONFIG_MAIN_STACK_SIZE=4096
```

## boards/arm/clicker4_stm32f7/Kconfig.board
```kconfig
# SPDX-License-Identifier: Apache-2.0

config BOARD_CLICKER4_STM32F7
    bool "MikroElektronika Clicker 4 STM32F7 Development Board"
    depends on SOC_STM32F745XG
    #select HAS_DTS
```

## boards/arm/clicker4_stm32f7/board.yml
```yaml
board:
  name: clicker4_stm32f7
  vendor: mikroe
  socs:
    - name: stm32f745xx
```

## boards/arm/clicker4_stm32f7/clicker4_stm32f7_defconfig
```kconfig
# Enable GPIO
CONFIG_GPIO=y

# Enable Clocks
CONFIG_CLOCK_CONTROL=y

# Enable pin controller
CONFIG_PINCTRL=y



# (Optional) Set default main stack size if needed
CONFIG_MAIN_STACK_SIZE=4096

# Enable USB device stack and CDC ACM by default
CONFIG_USB_DEVICE_INITIALIZE_AT_BOOT=y

CONFIG_USB_CDC_ACM=y
CONFIG_USB_DEVICE_STACK=y
CONFIG_USB_DEVICE_INITIALIZE_AT_BOOT=y
CONFIG_USB_DEVICE_PRODUCT="SVEA-LLI"
CONFIG_USB_DEVICE_VID=0x0000
CONFIG_USB_DEVICE_PID=0x0001
```

## drivers/dts/bindings/st,ism330dlc-i2c.yaml
```yaml
# Copyright (c) 2020 STMicroelectronics
# SPDX-License-Identifier: Apache-2.0

description: |
    STMicroelectronics ISM330DHCX 6-axis IMU (Inertial Measurement Unit) sensor
    accessed through I2C bus

compatible: "st,ism330dlc"

include: ["i2c-device.yaml", "st,ism330dlc-common.yaml"]
```

## drivers/st_ism330dlc/Kconfig
```kconfig
## SVEA Note.
##
## This is a copy/rewrite from the ISM330DHCX driver that exist in Zephyr tree.
## 
## Path: 
## zephyr/drivers/sensor/st/ism330dhcx
## 
## Author:
## Kaj Munhoz Arfvidsson


# ST Microelectronics ISM330DLC 6-axis IMU sensor driver

# Copyright (c) 2020 STMicroelectronics
# SPDX-License-Identifier: Apache-2.0

menuconfig ISM330DLC
	bool "ISM330DLC I2C/SPI accelerometer and gyroscope Chip"
	default y
	depends on ZEPHYR_HAL_ST_MODULE
	select I2C if $(dt_compat_on_bus,$(DT_COMPAT_ST_ISM330DLC),i2c)
	select SPI if $(dt_compat_on_bus,$(DT_COMPAT_ST_ISM330DLC),spi)
	select HAS_STMEMSC
	select USE_STDC_ISM330DLC
	help
	  Enable driver for ISM330DLC accelerometer and gyroscope
	  sensor.

if ISM330DLC

choice ISM330DLC_TRIGGER_MODE
	prompt "Trigger mode"
	help
	  Specify the type of triggering to be used by the driver.

config ISM330DLC_TRIGGER_NONE
	bool "No trigger"

config ISM330DLC_TRIGGER_GLOBAL_THREAD
	bool "Use global thread"
	depends on GPIO
	select ISM330DLC_TRIGGER

config ISM330DLC_TRIGGER_OWN_THREAD
	bool "Use own thread"
	depends on GPIO
	select ISM330DLC_TRIGGER

endchoice

config ISM330DLC_TRIGGER
	bool

if ISM330DLC_TRIGGER

config ISM330DLC_THREAD_PRIORITY
	int "Thread priority"
	depends on ISM330DLC_TRIGGER_OWN_THREAD
	default 10
	help
	  Priority of thread used by the driver to handle interrupts.

config ISM330DLC_THREAD_STACK_SIZE
	int "Thread stack size"
	depends on ISM330DLC_TRIGGER_OWN_THREAD
	default 1024
	help
	  Stack size of thread used by the driver to handle interrupts.

endif # ISM330DLC_TRIGGER

config ISM330DLC_ENABLE_TEMP
	bool "Temperature"
	help
	  Enable/disable temperature

config ISM330DLC_SENSORHUB
	bool "I2C sensorhub feature"
	help
	  Enable/disable internal sensorhub. You can enable
	  a maximum of two external sensors (if more than two are enabled
	  the system would enumerate only the first two found)

if ISM330DLC_SENSORHUB

config ISM330DLC_EXT_LIS2MDL
	bool "LIS2MDL as external sensor"

config ISM330DLC_EXT_IIS2MDC
	bool "IIS2MDC as external sensor"

config ISM330DLC_EXT_LPS22HH
	bool "LPS22HH as external sensor"

config ISM330DLC_EXT_HTS221
	bool "HTS221 as external sensor"

config ISM330DLC_EXT_LPS22HB
	bool "LPS22HB as external sensor"

endif # ISM330DLC_SENSORHUB

endif # ISM330DLC
```

## west-manifest/west.yml
```yaml
manifest:
  remotes:
    - name: zephyrproject
      url-base: https://github.com/zephyrproject-rtos
    - name: nilskiefer
      url-base: https://github.com/nilskiefer
  projects:
    - name: zephyr
      repo-path: zephyr
      remote: zephyrproject
      revision: v4.3.0
      clone-depth: 1
      import:
        path-prefix: external
        name-allowlist:
          - mcuboot
          - hal_st
          - hal_stm32
          - hal_espressif
          - hal_nxp
          - cmsis
          - cmsis_6
          - hal_tdk
          - segger
    - name: zenoh-pico
      remote: nilskiefer
      revision: c884167d434da6a56fe9f85d442d99108fbeeaf7
      path: modules/lib/zenoh-pico

  self:
    path: .

# Configure west to find custom boards
build:
  board-root: .
```
